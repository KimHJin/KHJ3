///////////////////////////////////////////////////////////////////////////////
// Code Name : IWON TEMP SCAN
//
// For STM8L0
//
// 2020/04/18 I-WON SOLUTION CO LTD
// 2020/04/18 v1.0 by KGY
///////////////////////////////////////////////////////////////////////////////

#include "IWON_SCAN.h"

// 센서 써미스터 특정 (소수점 연산을 위해서 1000 배수 한 것이다.)
// 범위 바뀌면 헤더 파일의 NTC_MIN, NTC_MAX 적용해야 함
const static INT32 NTC_TBL[] = {
		4251000, // -40
		3962000, // -39
		3695000, // -38
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		2634,		 // 124
		2561		 // 125
};

// 독일센서 (HMS J11 F5.5 & HMS K11 F5.5) 써미스터 특성
const static INT32 NTC_TBL1[] = {
1655000,	// -30
1234000,	// -25
928700,
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7635,		// 95
6551		// 100
};

// 28.1 ~ 41.5 (사물온도 기준)
// 33.4 ~ 42.5 (체온 기준)
// 테이블값 수정 (기본이된 중국 소스에 오류 있음) - 2020.05.23
// 136 개
/*
const static INT8 TB_TBL[] = {
		53, 53, 53, 53, 53, 53, 53, 52, 51, 50, 
		50, 50, 50, 50, 50, 50, 50, 50, 49, 48,
		48, 47, 47, 47, 46, 46, 46, 46, 46, 46, 
		46, 46, 46, 45, 45, 45, 44, 43, 43, 42,
		42, 41, 40, 39, 38, 38, 37, 36, 36, 35, 
		34, 34, 33, 32, 31, 30, 29, 28, 27, 26,
		25, 24, 23, 22, 21, 21, 20, 19, 18, 17, 
		16, 15, 15, 15, 14, 14, 14, 14, 13, 12,
		12, 12, 12, 12, 12, 12, 12, 12, 12, 12, 
		12, 12, 12, 12, 12, 12, 12, 12, 11, 10,
		10, 10, 10, 10, 10, 10, 10, 10, 10, 10, 
		10, 10, 10, 10, 10, 10, 10, 10, 10, 10, 
		10, 10, 10, 10, 10, 10, 10, 10, 10, 10, 
		10, 10, 10, 10, 10, 10};
*/

// 사물기준 28.1 ~ 42.2
// 체온기준 42.5 => 43.0 으로 변경해야 하므로 수량이 늘어남.
// 총 142 개로 늘어남.
/*
const static INT8 TB_TBL[] = {
		53, 52, 52, 51, 51, 51, 50, 50, 49, 49,
		48, 48, 47, 47, 46, 46, 45, 45, 45, 44,
		44, 43, 43, 42, 42, 42, 41, 41, 41, 41,
		40, 40, 40, 39, 39, 39, 38, 38, 38, 37, 
		37, 37, 36, 36, 36, 35, 35, 35, 34, 34, 
		33, 33, 32, 31, 31, 30, 30, 29, 29, 28, 
		27, 27, 26, 26, 25, 25, 24, 24, 23, 23, 
		23, 22, 22, 21, 21, 21, 20, 20, 19, 19, 
		19, 18, 18, 18, 17, 17, 17, 16, 16, 16, 
		15, 15, 15, 14, 14, 14, 14, 14, 13, 13, 
		13, 13, 13, 13, 13, 13, 13, 12, 12, 12, 
		12, 12, 12, 12, 12, 12, 12, 11, 11, 11, 
		11, 11, 11, 11, 11, 11, 11, 10, 10, 10, 
		10, 10, 10, 10, 10, 10,	// 여기까지 425
		10, 10, 10, 10, 10 };	// 430 까지 늘림
*/
// 새로운 보정 (28.1~42.2) 총 142개
const static INT16 TB_TBL[] = {
5300,
5249,
5199,
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780,
773
};

// 생성자
IWON_TEMP_SCAN::IWON_TEMP_SCAN()
{
	TSUMN = DEFINED_TSUMN; // 온도 평균값을 만들기 위하여 몇개의 방을 써야할지 결정
	TSUMC = 0;
	TSUMB = NULL;

	InitTSUMB();
}
IWON_TEMP_SCAN::IWON_TEMP_SCAN(INT8 tsumn)
{
	TSUMN = tsumn; // 온도 평균값을 만들기 위하여 몇개의 방을 써야할지 결정
	TSUMC = 0;
	TSUMB = NULL;

	InitTSUMB();
}

// 소멸자
IWON_TEMP_SCAN::~IWON_TEMP_SCAN()
{
	if (TSUMB != NULL)
		free(TSUMB);
}

// 온도 평균값 구하는 링 메모리를 생성한다.
VOID IWON_TEMP_SCAN::InitTSUMB(VOID)
{
	if (TSUMB != NULL)
		free(TSUMB);
	TSUMB = (INT16 *)malloc(sizeof(INT16) * TSUMN);
}

//-----------------------------------------------------------------------------
// NTC 기준 테이블 인덱스 넘버를 찾는다.
// 입력 : MRES = 센서의 써미스터 저항 값
// 출력 : MRES 가 위치하는 NTC 테이블 인덱스 위치
//-----------------------------------------------------------------------------
INT16 IWON_TEMP_SCAN::GetNTCIndex(INT32 MRES, INT8 SENSOR_TYPE)
{
	INT16 index = -1;
	INT16 tbl_count;
	INT32 *ntc_tbl;
	if(SENSOR_TYPE==1)	// 독일센서
	{
		// 독일센서
		tbl_count = (sizeof(NTC_TBL1) / sizeof(INT32)) - 1;
		ntc_tbl = (INT32*)&NTC_TBL1[0];
	}
	else
	{
		// 초기에 사용한 중국 막센서
		tbl_count = (sizeof(NTC_TBL) / sizeof(INT32)) - 1;
		ntc_tbl = (INT32*)&NTC_TBL[0];
	}
	
	for (;;)
	{
		index++;
		if (index == tbl_count)
			break;
		if (MRES > *(ntc_tbl+index))
			return index;
	}
	return -1;
}

// NTC 기준 인덱스 번호화 실측된 값을 이용해서 해당 구간내의 보정 위치의 퍼센트를 계산한다.
// 그 이유는 실제 측정된 온도값의 저항값의 인덱스는 해당 NTC 구간의 1도 분해능이기 때문에
// 그 사이의 정확한 온도를 계산하기 위해서 측정된 값이 해당 구간의 어느 위치에 있는지 알아야 하기 때문이다.
// 입력 : MRES 센서의 써미스터 저항 값
//       MRES 의 index 해당 NTC 인덱스 위치 값
// 출력 : 해당 NTC 구간의 입력된 MRES 의 위치 퍼센트 값
INT16 IWON_TEMP_SCAN::GetNTCValueRatio(INT32 MRES, INT16 index, INT8 SENSOR_TYPE)
{
	INT32 NTCRL;
	INT32 NTCRH;

	if(SENSOR_TYPE==1)	// 독일센서
	{
		NTCRL = NTC_TBL1[index];
		NTCRH = NTC_TBL1[index - 1];
	}
	else
	{
		NTCRL = NTC_TBL[index];
		NTCRH = NTC_TBL[index - 1];
	}

	INT32 RM = MRES - NTCRL;
	INT32 RD = NTCRH - NTCRL;

	INT16 PR = (INT16)(RM * 100 / RD);
	return PR;
}

// 사물 온도를 인체 온도로 변환
// 입력 : T_OBJ 는 측정된 사물 온도를 10 배수한 정수이다.
// 출력 : -110 = LO
//       -120 = HI
INT16 IWON_TEMP_SCAN::GetTBLValue(INT16 T_OBJ)
{
	if (T_OBJ < TB_MIN)
		return -110;
	if (T_OBJ > TB_MAX)
		return -120;
	return TB_TBL[T_OBJ - TB_MIN];
}

VOID IWON_TEMP_SCAN::ClearTSUMB(VOID)
{
	TSUMC = 0;
	for (INT16 i = 0; i < TSUMN; i++)
	{
		TSUMB[i] = -999;
	}
}
INT16 IWON_TEMP_SCAN::GetTSUMB()
{
	INT32 B = 0;
	INT16 C = 0;
	for (INT8 i = 0; i < TSUMN; i++)
	{
		if (TSUMB[i] == -999)
			continue;
		B += (INT32)TSUMB[i];
		C++;
	}
	if (C == 0)
		return -999;
	return (INT16)(B / C);
}
INT16 IWON_TEMP_SCAN::AddTSUMB(INT16 B)
{
	TSUMB[TSUMC] = B;
	TSUMC++;
	if (TSUMC == TSUMN)
		TSUMC = 0;
	return GetTSUMB();
}
